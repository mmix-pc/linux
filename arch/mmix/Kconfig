## arch/mmix/Kconfig
```kconfig
# SPDX-License-Identifier: GPL-2.0-only
config MMIX
	def_bool y
	select 64BIT
	select ARCH_BINFMT_ELF_STATE
	select ARCH_WANT_FRAME_POINTERS
	select ARCH_USE_QUEUED_RWLOCKS
	select CPU_BIG_ENDIAN
	select GENERIC_CLOCKEVENTS
	select GENERIC_CLOCKEVENTS_MIN_ADJUST
	select GENERIC_CPU_DEVICES
	select GENERIC_IRQ_MULTI_HANDLER
	select GENERIC_IRQ_SHOW
	select GENERIC_SCHED_CLOCK
	select GENERIC_SMP_IDLE_THREAD if SMP
	select HAVE_EXIT_THREAD
	select HAVE_ARCH_VMAP_STACK
	select HAVE_PAGE_SIZE_8KB
	select IRQCHIP
	select IRQ_DOMAIN
	select LOCK_MM_AND_FIND_VMA
	select OF
	select OF_EARLY_FLATTREE
	select SPARSE_IRQ
	select THREAD_INFO_IN_TASK

config 64BIT
	bool
	default y

config MMU
	def_bool y

config CPU_BIG_ENDIAN
	bool
	default y

config GENERIC_CALIBRATE_DELAY
	def_bool y

config GENERIC_HWEIGHT
	def_bool y

config GENERIC_CSUM
	def_bool y

config NO_IOPORT_MAP
	def_bool y

config PGTABLE_LEVELS
	int
	default 3

config SMP
	bool "MMIX multiprocessor boot preparation"
	help
	  Discover and prepare the fixed platform CPU population. Secondary CPUs
	  remain parked with interrupts masked and are not brought online until
	  interrupt, timer and remote MMU services are implemented. This staging
	  option does not yet enable multiprocessor scheduling. Leave disabled
	  for the qualified single-CPU environment.

config NR_CPUS
	int
	range 2 4 if SMP
	default 4 if SMP
	default 1

config MMIX_SMP_KERNEL
	bool "MMIX kernel-only multiprocessor scheduling"
	depends on SMP
	help
	  Bring prepared CPUs online with normal idle tasks and local clock
	  events. This staged mode admits kernel work only; native userspace
	  entry remains unavailable until remote MMU and ownership work is
	  qualified. Leave disabled for preparation-only or UP profiles.

source "kernel/Kconfig.hz"

config MMIX_THREAD_ENTRY
	bool "MMIX native thread entry"
	depends on VMAP_STACK && PREEMPTION
	depends on !SMP
	help
	  Enable the selected raw clone thread-entry profile. Keep disabled in
	  ordinary configurations until thread-group lifecycle and directed
	  signal handling have been qualified together with the userspace
	  runtime. This option does not provide pthread or compiler TLS support.

config MMIX_BOOT_TEST
	bool "MMIX integrated boot tests"
	depends on KUNIT=y
	depends on VMAP_STACK && PREEMPTION
	depends on !SMP
	select CRC32
	help
	  Exercise memory, exception, interrupt, thread and timer integration
	  through the built-in mmix_boot KUnit suite before userspace starts.
	  Includes fault injection for register-stack allocation and boot-time
	  negative controls. Leave disabled in ordinary kernel configurations.

config MMIX_USER_TEST
	bool "MMIX userspace resource observation"
	depends on DEBUG_FS
	help
	  Expose private user-state and scheduler register-stack live counts
	  through debugfs mmix/rstack_stats for userspace reclamation tests.
	  The companion mmix/signal_stats file reports live register-stack
	  domains and signal activations; mmix/vfork_stats reports outstanding
	  shared-mm continuation checkpoints.
	  This read-only test interface is not a userspace ABI. Leave disabled
	  in ordinary kernel configurations.

config MMIX_SIGNAL_TEST
	bool "MMIX signal runtime interrupt injection"
	depends on MMIX_USER_TEST
	help
	  Translate a user-mode interval-counter interrupt into SIGUSR2 for
	  debugger-controlled instruction-boundary signal tests. The platform
	  clock event device is independent of the interval counter. Tests must
	  explicitly enable and request this interrupt through the debugger.
	  Leave disabled in ordinary kernel configurations.
```

## arch/mmix/configs/mmix_userspace_defconfig
```kconfig
CONFIG_EXPERT=y
CONFIG_PREEMPT=y
CONFIG_HZ_100=y
CONFIG_HIGH_RES_TIMERS=y
CONFIG_VMAP_STACK=y
CONFIG_PRINTK=y
CONFIG_SERIAL_8250=y
CONFIG_SERIAL_8250_CONSOLE=y
CONFIG_SERIAL_OF_PLATFORM=y
# CONFIG_KUNIT is not set
# CONFIG_KUNIT_ALL_TESTS is not set
# CONFIG_MODULES is not set
# CONFIG_NET is not set
# CONFIG_BLOCK is not set
# CONFIG_VT is not set
# CONFIG_STACKPROTECTOR is not set
# CONFIG_FTRACE is not set
# CONFIG_INPUT is not set
CONFIG_BINFMT_ELF=y
CONFIG_BINFMT_SCRIPT=y
# CONFIG_COREDUMP is not set
# CONFIG_MMIX_BOOT_TEST is not set
CONFIG_TMPFS=y
CONFIG_BLK_DEV_INITRD=y
CONFIG_DEVTMPFS=y
CONFIG_PROC_FS=y
```

## arch/mmix/configs/mmix_virt_defconfig
```kconfig
CONFIG_EXPERT=y
CONFIG_PREEMPT=y
CONFIG_HZ_100=y
CONFIG_HIGH_RES_TIMERS=y
CONFIG_VMAP_STACK=y
CONFIG_PRINTK=y
CONFIG_SERIAL_8250=y
CONFIG_SERIAL_8250_CONSOLE=y
CONFIG_SERIAL_OF_PLATFORM=y
CONFIG_KUNIT=y
# CONFIG_KUNIT_ALL_TESTS is not set
# CONFIG_MODULES is not set
# CONFIG_NET is not set
# CONFIG_BLOCK is not set
# CONFIG_VT is not set
# CONFIG_STACKPROTECTOR is not set
# CONFIG_FTRACE is not set
# CONFIG_INPUT is not set
CONFIG_BINFMT_ELF=y
# CONFIG_BINFMT_SCRIPT is not set
# CONFIG_COREDUMP is not set
CONFIG_MMIX_BOOT_TEST=y
CONFIG_TMPFS=y
```
